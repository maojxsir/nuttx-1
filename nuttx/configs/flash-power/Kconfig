## nuttx/configs/flash-power/Kconfig
```kconfig
#
# For a description of the syntax of this configuration file,
# see misc/tools/kconfig-language.txt.
#

if ARCH_BOARD_FLASH_POWER
comment "Flash Power Configuration"

config GL_FLASHPOWER
    bool "Flash Power macro"
    default y

config SSD1289_WRONLY
    bool "SSD1289 Write only"
    default y

config LCD_ILI93XX
    bool "Flash Power ili93xx lcd driver"
    default y

config USBTMC_EPBULKOUTFICL
    int "Ficl command bulk out endpoint"
    default 1

config USBTMC_EPBULKINFICL
    int "Ficl command bulk in endpoint"
    default 2

config USBTMC_EPBULKOUTDATA
    int "DATA bulk out endpoint"
    default 3

config USBTMC_EPBULKINDATA
    int "DATA bulk in endpoint"
    default 4


endif
```

## nuttx/configs/superswitch/Kconfig
```kconfig
#
# For a description of the syntax of this configuration file,
# see misc/tools/kconfig-language.txt.
#

if ARCH_BOARD_SUPER_SWITCH
comment "Super Switch Hardware Configuration"

config SUPER_SWITCH_NSH_RELAY
        bool "Relay control in nsh. use stm32_writegpio"
        default n

endif
```
